#include <Gamebuino-Compat.h>

const uint16_t looserData[] = {80,64,1, 1, 0, 0, 0x0,0x0,0x0,0x0,0x0,0x0,0x0,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0x0,0x0};
Image looser = Image(looserData);

const uint16_t winnerData[] = {80,64,1, 1, 0, 0, 0x0,0x0,0x0,0x0,0x0,0x0,0x0,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0x0,0x0};
Image winner = Image(winnerData);

#define VITTESSE_SNAKE 2
enum Dir
{
  dir_up,
  dir_down,
  dir_left,
  dir_right
};
Dir allDir[4]{
dir_up,
dir_down,
dir_left,
dir_right
};

typedef struct {
  int8_t x,y,life;
  Dir dir;
  Color color;
}Snake;

Snake p1,p2;

enum gameMode
{
  gameMenu,
  game,
  gameOver
};
gameMode state = gameMenu;


void drwPlayer(Snake play);
void updPlayer(Snake *play);
void ia(Snake *play);
void human(Snake *play);

const char strSolo[] PROGMEM = "1 player";
const char* const multiPlayerMenu[1] PROGMEM = {
  strSolo
};

#define FACILE 7
#define MOYEN 15
#define DIFFICILE 25


/*MASTER*/
#define P1_X 10
#define P1_Y 11
#define P1_ALIVE 12
#define P2_X 20 
#define P2_Y 21
#define P2_ALIVE 22

/* fake button for slave*/
boolean bt_up,bt_down,bt_left,bt_right,bt_a,bt_b;

boolean isPaused = false;
byte difficulter;

void setup()
{
  gb.begin();
  initPrograme();
}

void initPrograme()
{
  state = gameMenu;
  gb.setFrameRate(15);
  difficulter = 15;
}

void goTitleScreen()
{
    state = gameMenu;
}

void initGame()
{
  gb.display.clear();
  gb.display.persistence = true;
  gb.display.drawFastVLine(0, 0, gb.display.height());
  gb.display.drawFastVLine(1, 0, gb.display.height());
  gb.display.drawFastVLine(78, 0, gb.display.height());
  gb.display.drawFastVLine(79, 0, gb.display.height());
  gb.display.drawFastHLine(0, 0, gb.display.width());
  gb.display.drawFastHLine(0, 1, gb.display.width());
  gb.display.drawFastHLine(0, 62, gb.display.width());
  gb.display.drawFastHLine(0, 63, gb.display.width());
  p1.x = 10;
  p1.y = 10;
  p1.dir = dir_right;
  p1.life = 1;
  p1.color = RED;
  p2.x = 74;
  p2.y = 38;
  p2.dir = dir_left;
  p2.life = 1;
  p2.color = BLUE;
}

void loop()
{
    if(gb.update())
    {
      gb.display.setColor(BLACK);
      if(gb.buttons.pressed(BTN_C))
      {
        goTitleScreen();
      }
      
      switch(state)
      {
        case gameMenu :
        //multiplayer menu
        switch(gb.menu(multiPlayerMenu,1)){
          case 0: //single      
            isPaused = false;
            initDifficulty();
            break;
          default:
            state = gameMenu;
            break;
         }
          initGame();
          state = game;
        break;
        case game :
          if(!isPaused)
          {
            human(&p1);
            ia(&p2);
            updatePlayer();
          }
          
          drawPlayer();

          if(p1.life == 0 || p2.life == 0)
          {
            state = gameOver;
            gb.setFrameRate(20);//Normal frameRate 
          }
        break;
        case gameOver :
          gb.display.clear();
          gb.display.persistence = false;
          if(p1.life == 0)
            gb.display.drawImage(0,0,looser);
          else 
            gb.display.drawImage(0,0,winner);
            
          if(gb.buttons.pressed(BTN_B))
          {
            state = gameMenu;
          }
          if(gb.buttons.pressed(BTN_A))
          {
            initGame();
            gb.setFrameRate(difficulter);
            state = game;
          }
            
        break;
      }
    }
}

const char strFacile[] PROGMEM = "Easy";
const char strHard[] PROGMEM = "Hard";
const char strInsane[] PROGMEM = "Insane";
const char* const difficultyMenu[3] PROGMEM = {
  strFacile,
  strHard,  
  strInsane
};

void initDifficulty()
{
     switch(gb.menu(difficultyMenu, 3)){
          case 0:     
            gb.setFrameRate(FACILE);
              difficulter = FACILE;
            break;
          case 1 :     
            gb.setFrameRate(MOYEN);  
              difficulter = MOYEN;
            break;
          case 2:     
            gb.setFrameRate(DIFFICILE); 
              difficulter = DIFFICILE;
            break;
          default:
            state = gameMenu;
            break;
         }
}
